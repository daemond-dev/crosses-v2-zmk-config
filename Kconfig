## Kconfig
```kconfig
DT_COMPAT_ZMK_BATTERY_NRF_VDDH_MV := zmk,battery-nrf-vddh-mv

config ZMK_BATTERY_NRF_VDDH_MV
    bool
    default $(dt_compat_enabled,$(DT_COMPAT_ZMK_BATTERY_NRF_VDDH_MV))
    select ADC
    select ZMK_BATTERY
    depends on SENSOR
```

## config/west.yml
```yaml
manifest:
  defaults:
    revision: main
  remotes:
    - name: Good-Great-Grand-Wonderful
      url-base: https://github.com/Good-Great-Grand-Wonderful
    - name: zzeneg
      url-base: https://github.com/zzeneg
    - name: srwi
      url-base: https://github.com/srwi
  projects:
    - name: crosses-v2-zmk-firmware
      remote: Good-Great-Grand-Wonderful
      import: config/west.yml
    - name: zmk-raw-hid
      remote: zzeneg
      revision: main
    - name: zmk-keypeek-layer-notifier
      remote: srwi
      revision: master
  self:
    path: config
```

## dts/bindings/sensor/zmk,battery-nrf-vddh-mv.yaml
```yaml
description: |
  Diagnostic nRF VDDH battery sensor. Reports voltage through the state of charge
  channel: level = (mV - 2500) / 20, clamped to 1..100. Read back as mV = 2500 + 20 * level.

compatible: "zmk,battery-nrf-vddh-mv"
```
